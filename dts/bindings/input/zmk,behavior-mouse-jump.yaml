## dts/bindings/input/zmk,behavior-mouse-jump.yaml
```yaml
# SPDX-License-Identifier: MIT

description: |
  Moves the cursor in steps while held: one step on press, then another step
  after every repeat delay until release. Step size and delay come from the
  levels set with zmk,behavior-mouse-speed for the active BLE profile.

compatible: "zmk,behavior-mouse-jump"

include: one_param.yaml

properties:
  horizontal-mul:
    type: int
    default: 1
    description: Horizontal steps are the vertical step times horizontal-mul / horizontal-div
  horizontal-div:
    type: int
    default: 1
```

## dts/bindings/input/zmk,behavior-mouse-speed.yaml
```yaml
# SPDX-License-Identifier: MIT

description: |
  Steps the keyboard cursor speed, scroll speed, jump step or jump delay up or
  down, or toggles scroll reversal, for the active BLE profile

compatible: "zmk,behavior-mouse-speed"

include: one_param.yaml
```

## dts/bindings/input/zmk,input-processor-mouse-speed.yaml
```yaml
# SPDX-License-Identifier: MIT

description: Scales cursor and wheel movement by the stored speed levels and by mul/div params

compatible: "zmk,input-processor-mouse-speed"

include: ip_two_param.yaml
```
